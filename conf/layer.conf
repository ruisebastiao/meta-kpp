## conf/layer.conf
```bitbake
# We have a conf and classes directory, append to BBPATH
BBPATH .= ":${LAYERDIR}"

BBFILES += "${LAYERDIR}/recipes-*/*/*.bb \
                 ${LAYERDIR}/recipes-*/*/*.bbappend"

BBFILE_COLLECTIONS += "kpp"
BBFILE_PATTERN_kpp := "^${LAYERDIR}/"
BBFILE_PRIORITY_kpp = "7"

LAYERDEPENDS_kpp = "yocto qt5-layer openembedded-layer"

LICENSE_PATH += "${LAYERDIR}/licenses"
```

## meta-bbb/conf/layer.conf
```bitbake
# We have a conf and classes directory, add to BBPATH
BBPATH .= ":${LAYERDIR}"

# We have recipes-* directories, add to BBFILES
BBFILES += "${LAYERDIR}/recipes-*/*/*.bb \
	${LAYERDIR}/recipes-*/*/*.bbappend"

BBFILE_COLLECTIONS += "kpp-bbb"
BBFILE_PATTERN_kpp-bbb = "^${LAYERDIR}/"
BBFILE_PRIORITY_kpp-bbb = "6"

LAYERDEPENDS_kpp-bbb = "kpp meta-ti"
```

## meta-bbb/conf/machine/beaglebone.conf
```bitbake
#@TYPE: Machine
#@NAME: BeagleBone machine
#@DESCRIPTION: Machine configuration for the http://beagleboard.org/bone board 

require conf/machine/include/ti33x.inc

# Only has DVI connector for external screen
GUI_MACHINE_CLASS = "bigscreen"

IMAGE_FSTYPES += "tar.gz"

SERIAL_CONSOLE = "115200 ttyO0"

UBOOT_MACHINE = "am335x_boneblack_config"

PREFERRED_VERSION_libgles-omap3 = "5.01.01.02"
PREFERRED_PROVIDER_virtual/egl = "libgles-omap3"
PREFERRED_PROVIDER_virtual/libgles1 = "libgles-omap3"
PREFERRED_PROVIDER_virtual/libgles2 = "libgles-omap3"
PREFERRED_PROVIDER_virtual/kernel = "beagleboard-linux"
#PREFERRED_VERSION_virtual/kernel = "3.14.50"
PREFERRED_VERSION_virtual/kernel = "4.0"
PREFERRED_PROVIDER_virtual/bootloader = "u-boot"
PREFERRED_VERSION_u-boot = "2015.%"
PREFERRED_PROVIDER_jpeg = "libjpeg-turbo"
PREFERRED_VERSION_opencv = "3.%"
PREFERRED_VERSION_gstreamer = "1.%"
```

## meta-cubie/conf/layer.conf
```bitbake
# We have a conf and classes directory, add to BBPATH
BBPATH .= ":${LAYERDIR}"

# We have recipes-* directories, add to BBFILES
BBFILES += "${LAYERDIR}/recipes-*/*/*.bb \
	${LAYERDIR}/recipes-*/*/*.bbappend"

BBFILE_COLLECTIONS += "kpp-cubie"
BBFILE_PATTERN_kpp-cubie = "^${LAYERDIR}/"
BBFILE_PRIORITY_kpp-cubie = "11"

LAYERDEPENDS_kpp-cubie = "kpp meta-sunxi"
```

## meta-kppwireless/conf/layer.conf
```bitbake
# We have a conf and classes directory, add to BBPATH
BBPATH .= ":${LAYERDIR}"

# We have recipes-* directories, add to BBFILES
BBFILES += "${LAYERDIR}/recipes-*/*/*.bb \
	${LAYERDIR}/recipes-*/*/*.bbappend"

BBFILE_COLLECTIONS += "kppwireless"
BBFILE_PATTERN_kppwireless = "^${LAYERDIR}/"
BBFILE_PRIORITY_kppwireless = "10"

#LAYERDEPENDS_kpp-cubie = "kpp meta-sunxi"
```

## meta-rpi/conf/layer.conf
```bitbake
# We have a conf and classes directory, add to BBPATH
BBPATH .= ":${LAYERDIR}"

# We have recipes-* directories, add to BBFILES
BBFILES += "${LAYERDIR}/recipes-*/*/*.bb \
	${LAYERDIR}/recipes-*/*/*.bbappend"

BBFILE_COLLECTIONS += "rpi"
BBFILE_PATTERN_rpi = "^${LAYERDIR}/"
BBFILE_PRIORITY_rpi = "6"

LAYERDEPENDS_rpi = "kpp raspberrypi"
```
